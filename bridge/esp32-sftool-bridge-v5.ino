// SiFli readback transport: CH343 control/log, native USB raw SFTool data.
// T->GPIO4, R->GPIO5. GPIO5 floats between transmissions. ARM PROBE performs
// fixed reads only. ARM SFT52 permits SFTool traffic only after a 52-like ID.
// Flash erase/write operations must never be invoked by the host readback task.
#include <Arduino.h>
#include "HWCDC.h"
#include "driver/gpio.h"
#include "driver/uart.h"

static HardwareSerial pc(0);
static HWCDC dataUSB;
static constexpr uart_port_t U = UART_NUM_1;
static constexpr gpio_num_t PIN_RX = GPIO_NUM_4;
static constexpr gpio_num_t PIN_TX = GPIO_NUM_5;
static const uint8_t enterLong[] = {
  0x7e,0x79,0,8,0,0,0,0,0x10,0,0,0,0x41,0x54,0x53,0x46,0x33,0x32,5,0x21};
static const uint8_t enterAck[] = {0x7e,0x79,2,0,0x10,0,0xd1,6};
static const uint8_t enterShort[] = {0x7e,0x79,8,0,0x10,0,0x41,0x54,0x53,0x46,0x33,0x32,5,0x21};
enum Mode { OFF, PROBE, SFT52 };
static Mode mode = OFF;
static int stage = 0; // 1=Enter,2=CPUID,3=IDR,4=flash head
static bool active = false, known52 = false;
static uint32_t cpuid = 0, chipId = 0, armMs = 0, stageMs = 0;
static uint32_t nativeTx = 0, nativeRx = 0, bootCount = 0;
static unsigned signature = 0;
static uint8_t packet[256];
static size_t packetSize = 0;
static char control[64];
static size_t controlSize = 0;
static bool pendingHostEnter = false;
static uint8_t pendingWindow[sizeof(enterShort)];
static size_t pendingSize = 0;
static bool debugFramed = true;
static uint8_t hostPacket[2048];
static size_t hostPacketSize = 0;
static uint32_t hostFrames = 0;
static uint32_t currentBaud = 1000000;
static bool uartReady = false;
// v5 diagnostics only: no behaviour change in the data path.
static QueueHandle_t uartQueue = nullptr;
static uint32_t errFrame = 0, errParity = 0, errFifoOvf = 0, errBufFull = 0, errBreak = 0, sfblSeen = 0;
static uint32_t lastActiveMs = 0, maxRxGapMs = 0, lastRxMs = 0, rxBytesTotal = 0;
static char shellLine[96];
static size_t shellSize = 0, bannerRemaining = 0;

static void floatTx() {
  gpio_reset_pin(PIN_TX);
  gpio_set_direction(PIN_TX, GPIO_MODE_INPUT);
  gpio_set_pull_mode(PIN_TX, GPIO_FLOATING);
}
static void disarm() {
  mode=OFF; active=false; stage=0; signature=0; packetSize=0;
  pendingHostEnter=false;pendingSize=0;floatTx();
  hostPacketSize=0;debugFramed=true;
  shellSize=0;bannerRemaining=0;
  if (uartReady) uart_set_baudrate(U,1000000);
  currentBaud=1000000;
}
static void check(esp_err_t error, const char *where) {
  if (error==ESP_OK) return;
  disarm();
  pc.printf("{\"event\":\"fatal\",\"stage\":\"%s\",\"error\":%d}\n",where,error);
  while (true) delay(1000);
}
static void transmit(const uint8_t *bytes, size_t count) {
  check(uart_set_pin(U,PIN_TX,PIN_RX,UART_PIN_NO_CHANGE,UART_PIN_NO_CHANGE),"tx_attach");
  check(gpio_set_pull_mode(PIN_RX,GPIO_FLOATING),"rx_no_pull");
  int sent=uart_write_bytes(U,bytes,count);
  esp_err_t drained=uart_wait_tx_done(U,pdMS_TO_TICKS(20));
  floatTx();
  if (sent!=int(count) || drained!=ESP_OK) check(ESP_FAIL,"tx_incomplete");
}
static void info() {
  pc.printf("{\"event\":\"info\",\"firmware\":\"sftool-bridge-v5\",\"rx_gpio\":4,"
            "\"tx_gpio\":5,\"baud\":1000000,\"mode\":%d,\"known52\":%s,"
            "\"cpuid\":%lu,\"chip_id\":%lu,\"tx_floating\":true}\n",
            int(mode),known52?"true":"false",(unsigned long)cpuid,(unsigned long)chipId);
}
static void readFixed(uint32_t address, uint16_t words) {
  uint8_t frame[]={0x7e,0x79,8,0,0x10,0,0x40,0x72,
    uint8_t(address),uint8_t(address>>8),uint8_t(address>>16),uint8_t(address>>24),
    uint8_t(words),uint8_t(words>>8)};
  transmit(frame,sizeof(frame)); stageMs=millis();
  pc.printf("{\"event\":\"rom_read_tx\",\"address\":%lu,\"words\":%u}\n",
            (unsigned long)address,words);
}
static void handlePacket(const uint8_t *p, size_t size) {
  if (stage==1 && size==sizeof(enterAck) && !memcmp(p,enterAck,sizeof(enterAck))) {
    pc.println("{\"event\":\"enter_ack\",\"format\":\"short\"}");
    // Consume this bootstrap ACK locally and verify identity on every boot.
    // The host receives only replies generated by its own subsequent frames.
    pc.println("{\"event\":\"bootstrap_ack_consumed\"}");
    cpuid=0;chipId=0;known52=false;
    stage=2;readFixed(0xe000ed00,1);
    return;
  }
  if (mode==OFF || p[6]!=0xd2) return;
  if ((stage==2 || stage==3) && size==12) {
    uint32_t value=uint32_t(p[7])|(uint32_t(p[8])<<8)|(uint32_t(p[9])<<16)|(uint32_t(p[10])<<24);
    pc.printf("{\"event\":\"rom_word\",\"stage\":%d,\"value\":%lu,\"hex\":\"%08lx\"}\n",
              stage,(unsigned long)value,(unsigned long)value);
    if (stage==2) {cpuid=value;stage=3;readFixed(0x5000b004,1);}
    else {
      chipId=value;
      known52=((cpuid>>24)==0x41) && (((chipId>>16)&0xff)==4);
      if (mode==PROBE) {stage=4;readFixed(0x10000000,8);}
      else if (!known52) {disarm();pc.println("{\"event\":\"rejected\",\"reason\":\"chip_id_mismatch\"}");}
      else {
        stage=0;active=true;lastActiveMs=millis();
        if (pendingHostEnter) {
          pendingHostEnter=false;pendingSize=0;
          transmit(enterShort,sizeof(enterShort));nativeTx+=sizeof(enterShort);
        }
        pc.println("{\"event\":\"raw_bridge_active\",\"chip_verified_this_boot\":true}");
      }
    }
  } else if (stage==4 && size==40) {
    pc.print("{\"event\":\"flash_head\",\"address\":268435456,\"bytes\":32,\"hex\":\"");
    for (size_t i=7;i<39;i++) pc.printf("%02x",p[i]);
    pc.printf("\",\"known52\":%s}\n",known52?"true":"false");
    disarm();
    pc.println("{\"event\":\"probe_done\"}");
  }
}
static void parseByte(uint8_t b) {
  if (packetSize>=sizeof(packet)) packetSize=0;
  packet[packetSize++]=b;
  while (packetSize>=2 && (packet[0]!=0x7e || packet[1]!=0x79)) {
    memmove(packet,packet+1,--packetSize);
  }
  if (packetSize<6) return;
  size_t payload=packet[2]|(size_t(packet[3])<<8);
  if (payload<2 || payload>128 || packet[4]!=0x10 || packet[5]!=0) {
    memmove(packet,packet+1,--packetSize); return;
  }
  if (packetSize==payload+6) {
    handlePacket(packet,packetSize); packetSize=0;
  }
}
static void trackShell(const uint8_t *bytes, size_t size) {
  for (size_t i=0;i<size;i++) {
    uint8_t c=bytes[i];
    if (c=='\r' || c=='\n') {
      shellLine[shellSize]=0;
      uint32_t speed=0;
      if (!strcmp(shellLine,"burn_speed 2000000 10")) speed=2000000;
      else if (!strcmp(shellLine,"burn_speed 1000000 10")) speed=1000000;
      if (speed) {
        // The command has already fully left UART at the previous rate.
        // SFTool's SetBaud intentionally does not wait for an old-rate reply.
        check(uart_set_baudrate(U,speed),"baud_change");currentBaud=speed;
        pc.printf("{\"event\":\"uart_baud_changed\",\"baud\":%lu}\n",(unsigned long)speed);
      }
      shellSize=0;
    } else if (c>=32 && c<127 && shellSize<sizeof(shellLine)-1) shellLine[shellSize++]=char(c);
    else shellSize=0;
  }
}
static void sendHostData(const uint8_t *bytes, size_t size) {
  if (!debugFramed) {transmit(bytes,size);nativeTx+=size;trackShell(bytes,size);return;}
  if (hostPacketSize+size>sizeof(hostPacket)) check(ESP_ERR_INVALID_SIZE,"host_frame_buffer");
  memcpy(hostPacket+hostPacketSize,bytes,size);hostPacketSize+=size;
  while (hostPacketSize>=6) {
    if (hostPacket[0]!=0x7e || hostPacket[1]!=0x79 || hostPacket[4]!=0x10 || hostPacket[5]!=0)
      check(ESP_ERR_INVALID_ARG,"host_frame_header");
    size_t payload=hostPacket[2]|(size_t(hostPacket[3])<<8);
    if (payload<2 || payload>1024) check(ESP_ERR_INVALID_SIZE,"host_frame_length");
    size_t total=payload+6;
    if (hostPacketSize<total) return;
    bool exiting=payload==8 && !memcmp(hostPacket+6,"ATSF32\x18!",8);
    transmit(hostPacket,total);nativeTx+=total;hostFrames++;
    memmove(hostPacket,hostPacket+total,hostPacketSize-total);hostPacketSize-=total;
    if (exiting) {
      debugFramed=false;
      shellSize=0;bannerRemaining=2048;
      pc.println("{\"event\":\"host_exit_to_stub_shell\"}");
      if (hostPacketSize) {transmit(hostPacket,hostPacketSize);nativeTx+=hostPacketSize;trackShell(hostPacket,hostPacketSize);hostPacketSize=0;}
      return;
    }
  }
}
static void drainUartEvents() {
  uart_event_t ev;
  while (uartQueue && xQueueReceive(uartQueue,&ev,0)==pdTRUE) {
    switch (ev.type) {
      case UART_FRAME_ERR: errFrame++; break;
      case UART_PARITY_ERR: errParity++; break;
      case UART_FIFO_OVF: errFifoOvf++; break;
      case UART_BUFFER_FULL: errBufFull++; break;
      case UART_BREAK: errBreak++; break;
      default: break;
    }
  }
}
void setup() {
  floatTx();
  gpio_reset_pin(PIN_RX);
  gpio_set_direction(PIN_RX,GPIO_MODE_INPUT);
  gpio_set_pull_mode(PIN_RX,GPIO_FLOATING);
  pc.begin(921600,SERIAL_8N1,44,43);
  uart_config_t config={};config.baud_rate=1000000;config.data_bits=UART_DATA_8_BITS;
  config.parity=UART_PARITY_DISABLE;config.stop_bits=UART_STOP_BITS_1;
  config.flow_ctrl=UART_HW_FLOWCTRL_DISABLE;config.source_clk=UART_SCLK_DEFAULT;
  check(uart_param_config(U,&config),"uart_config");
  check(uart_set_pin(U,UART_PIN_NO_CHANGE,PIN_RX,UART_PIN_NO_CHANGE,UART_PIN_NO_CHANGE),"rx_attach");
  check(uart_driver_install(U,32768,0,32,&uartQueue,0),"uart_install");
  uartReady=true;
  check(gpio_set_pull_mode(PIN_RX,GPIO_FLOATING),"rx_no_pull");
  floatTx();
  dataUSB.setRxBufferSize(32768);dataUSB.setTxBufferSize(32768);
  dataUSB.setTxTimeoutMs(1000);dataUSB.begin(1000000);
  delay(100);pc.println();info();
}
void loop() {
  while (pc.available()) {
    char c=pc.read();
    if (c=='\n') {
      control[controlSize]=0;
      if (!strcmp(control,"INFO")) info();
      else if (!strcmp(control,"DISARM")) {disarm();pc.println("{\"event\":\"disarmed\"}");}
      else if (!strcmp(control,"ARM PROBE") || !strcmp(control,"ARM SFT52")) {
        bool wantBridge=!strcmp(control,"ARM SFT52");
        disarm();
        {
          check(uart_flush_input(U),"arm_flush");
          while (dataUSB.available()) dataUSB.read();
          mode=wantBridge?SFT52:PROBE;armMs=millis();
          pc.printf("{\"event\":\"armed\",\"mode\":%d,\"seconds\":120,\"verify_before_forward\":true}\n",int(mode));
        }
      } else pc.println("{\"event\":\"control_rejected\"}");
      controlSize=0;
    } else if (c!='\r') {
      if (controlSize<sizeof(control)-1) control[controlSize++]=c;
      else {controlSize=0;disarm();}
    }
  }
  if (mode!=OFF && millis()-armMs>=120000) {disarm();pc.println("{\"event\":\"expired\"}");}
  if (stage && millis()-stageMs>1000) {disarm();pc.println("{\"event\":\"probe_timeout\"}");}
  uint8_t rx[512];int count=uart_read_bytes(U,rx,sizeof(rx),0);
  drainUartEvents();
  if (count>0) {
    uint32_t nowMs=millis();
    if (lastRxMs && nowMs-lastRxMs>maxRxGapMs) maxRxGapMs=nowMs-lastRxMs;
    lastRxMs=nowMs; rxBytesTotal+=count;
    bool wasActive=active;
    if (wasActive) {
      size_t n=dataUSB.write(rx,count);nativeRx+=n;
      if (n!=size_t(count)) {disarm();pc.println("{\"event\":\"native_rx_short_write\"}");}
      if (!debugFramed && bannerRemaining) {
        size_t logSize=min(size_t(count),bannerRemaining);bannerRemaining-=logSize;
        pc.print("{\"event\":\"stub_banner\",\"hex\":\"");
        for (size_t j=0;j<logSize;j++) pc.printf("%02x",rx[j]);
        pc.println("\"}");
      }
    }
    for (int i=0;i<count;i++) {
      static const char sig[]="SFBL";
      if (rx[i]==uint8_t(sig[signature])) signature++;
      else signature=rx[i]=='S'?1:0;
      if (signature==4) {
        signature=0;
        sfblSeen++;
        pc.printf("{\"event\":\"sfbl_seen\",\"ms\":%lu,\"since_active_ms\":%lu,\"active\":%s,\"stage\":%d,\"framed\":%s,\"rx_level\":%d}\n",
                  (unsigned long)millis(),(unsigned long)(lastActiveMs?millis()-lastActiveMs:0),active?"true":"false",stage,debugFramed?"true":"false",gpio_get_level(PIN_RX));
        // Raw flash payload can itself contain the ASCII bytes SFBL. Never
        // treat those as target resets once the RAM-stub shell is active.
        if (mode!=OFF && debugFramed) {
          active=false;stage=1;packetSize=0;stageMs=millis();bootCount++;
          hostPacketSize=0;debugFramed=true;
          transmit(enterLong,sizeof(enterLong));
          pc.println("{\"event\":\"boot_enter_tx\",\"bytes\":20}");
        }
      }
      if (stage) parseByte(rx[i]);
    }
  }
  if (dataUSB.available()) {
    uint8_t tx[512];size_t countUSB=dataUSB.read(tx,sizeof(tx));
    if (mode==SFT52 && active && countUSB) sendHostData(tx,countUSB);
    else if (mode==SFT52) {
      // Retain exactly one complete host Enter while waiting for printer boot.
      // Collapse retries, never queue arbitrary writes across a target reset.
      for (size_t i=0;i<countUSB;i++) {
        if (pendingSize==sizeof(pendingWindow)) {
          memmove(pendingWindow,pendingWindow+1,sizeof(pendingWindow)-1);pendingSize--;
        }
        pendingWindow[pendingSize++]=tx[i];
        if (pendingSize==sizeof(enterShort) && !memcmp(pendingWindow,enterShort,sizeof(enterShort))) {
          pendingHostEnter=true;pendingSize=0;
        }
      }
    }
  }
  static uint32_t lastHeartbeat=0;
  if (millis()-lastHeartbeat>=1000) {
    lastHeartbeat=millis();
    pc.printf("{\"event\":\"heartbeat\",\"ticks_ms\":%lu,\"mode\":%d,\"stage\":%d,"
              "\"active\":%s,\"rx_level\":%d,\"native_tx\":%lu,\"native_rx\":%lu,\"boots\":%lu,\"host_frames\":%lu,\"uart_baud\":%lu,"
              "\"err_frame\":%lu,\"err_parity\":%lu,\"err_fifo_ovf\":%lu,\"err_buf_full\":%lu,\"err_break\":%lu,\"sfbl\":%lu,\"max_rx_gap_ms\":%lu,\"rx_total\":%lu}\n",
              (unsigned long)millis(),int(mode),stage,active?"true":"false",gpio_get_level(PIN_RX),
              (unsigned long)nativeTx,(unsigned long)nativeRx,(unsigned long)bootCount,(unsigned long)hostFrames,(unsigned long)currentBaud,
              (unsigned long)errFrame,(unsigned long)errParity,(unsigned long)errFifoOvf,(unsigned long)errBufFull,(unsigned long)errBreak,(unsigned long)sfblSeen,(unsigned long)maxRxGapMs,(unsigned long)rxBytesTotal);
  }
  delay(1);
}
